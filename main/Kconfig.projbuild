## main/Kconfig.projbuild
```kconfig
menu "espDrop"

config ESPDROP_DEVICE_NAME
    string "AirDrop device name"
    default "espDrop"

config ESPDROP_MAX_TRANSFER_BYTES
    int "Maximum accepted transfer size"
    range 1024 2147483647
    default 67108864

config ESPDROP_AWDL_PROBE
    bool "Enable receive-only AWDL action-frame probe"
    default y

config ESPDROP_AWDL_PROBE_CHANNEL
    int "AWDL probe channel"
    depends on ESPDROP_AWDL_PROBE
    range 1 13
    default 6

config ESPDROP_AWDL_TX_LAB
    bool "Enable bounded AWDL action/data transmit experiment"
    depends on ESPDROP_AWDL_PROBE
    default n
    help
        Research-only profile. After observing an OWL-valid MIF, derive and
        seed the peer's RFC4291 link-local mapping, then transmit PSF/MIF and
        queued IPv6 frames in bounded common windows for 15 seconds. The TLS
        sub-profile extends that bound to 25 seconds. Normal and web-flasher
        builds must leave this disabled.

config ESPDROP_AWDL_ACTIVE_RX_LAB
    bool "Bind the private station RX policy to the AWDL BSSID"
    depends on ESPDROP_AWDL_TX_LAB
    default n
    help
        Research-only ESP32-S3/ESP-IDF 5.4 experiment. After promiscuous mode
        starts, bind the Wi-Fi blob's normal station pre-authentication RX
        policy to the AWDL BSSID. This tests whether the closed firmware can
        receive and automatically acknowledge directed AWDL data while still
        exposing frames to the promiscuous callback. It uses undocumented
        symbols, is version-pinned, and must remain disabled in production and
        web-flasher builds.

config ESPDROP_AWDL_NETIF
    bool "Attach decoded AWDL IPv6 to an ESP-IDF network interface"
    depends on ESPDROP_AWDL_PROBE
    default y
    help
        Creates an Ethernet-shaped esp-netif for lwIP and feeds it decoded
        AWDL frames. Normal firmware suppresses all packets lwIP asks the
        driver to transmit; radio output remains restricted to a lab profile.

config ESPDROP_BLE_WAKE_LAB
    bool "Emit a bounded AirDrop BLE wake advertisement"
    depends on ESPDROP_AWDL_TX_LAB && BT_NIMBLE_ENABLED
    default n
    help
        Broadcast the Apple Continuity AirDrop record that wakes an
        Everyone-mode receiver and causes it to publish its AirDrop service.
        The four contact short-hash fields are zero. This is an attended lab
        profile; normal and web-flasher builds leave it disabled.

config ESPDROP_BLE_WAKE_DURATION_MS
    int "AirDrop BLE wake duration (milliseconds)"
    depends on ESPDROP_BLE_WAKE_LAB
    range 1000 600000
    default 120000

config ESPDROP_AWDL_MDNS_LAB
    bool "Run bounded IPv6 mDNS query through the AWDL netif"
    depends on ESPDROP_AWDL_NETIF && ESPDROP_AWDL_TX_LAB
    default n
    help
        Joins ff02::fb on the AWDL interface and sends six PTR queries for
        _airdrop._tcp.local after the selected peer supplies an OWL-valid MIF
        with version and device class. Only use in the bounded transmit lab.

config ESPDROP_AIRDROP_TLS_LAB
    bool "Perform one bounded AirDrop TLS client handshake"
    depends on ESPDROP_AWDL_MDNS_LAB
    default n
    help
        After TCP reaches a dynamically resolved AirDrop receiver, perform one
        TLS handshake using a lab-only self-signed client certificate. Peer
        certificate verification is disabled to match OpenDrop's documented
        Everyone-mode behavior. Normal and web-flasher builds must leave this
        disabled.

config ESPDROP_AIRDROP_RECEIVER_ORACLE_LAB
    bool "Advertise an identity-free AirDrop receiver oracle"
    depends on ESPDROP_AWDL_MDNS_LAB && !ESPDROP_AIRDROP_TLS_LAB
    default n
    help
        Publish a legacy _airdrop._tcp service with no Apple validation
        record so a native sender must use the anonymous Everyone path. This
        The bounded oracle advertises native discovery and accepts TLS
        /Discover so a stock sender can resolve its display name. It does not
        yet accept /Ask, /Upload, or files. Normal and web-flasher builds leave
        this disabled.

config ESPDROP_AIRDROP_RECEIVER_ORACLE_PORT
    int "Receiver oracle TLS port"
    depends on ESPDROP_AIRDROP_RECEIVER_ORACLE_LAB
    range 1024 65535
    default 8771

config ESPDROP_AIRDROP_ASK_LAB
    bool "Issue one bounded AirDrop /Ask on a sender connection"
    depends on ESPDROP_AIRDROP_TLS_LAB
    default n
    help
        After DNS-SD discovery, open the sender TLS connection with one
        synthetic hello.jpg transfer intent and record its bounded response.
        This follows OpenDrop's send flow: /Ask is the first request on this
        connection, rather than following /Discover. It can create an AirDrop
        prompt on the receiver. It never sends /Upload. Enable only for an
        attended lab run with explicit user consent.

config ESPDROP_AIRDROP_UPLOAD_LAB
    bool "Stream one bounded outgoing file after accepted /Ask"
    depends on ESPDROP_AIRDROP_ASK_LAB
    default n
    help
        After the user accepts the attended /Ask, stream the registered relay
        file (or the deterministic JPEG fixture when none is registered)
        through a 2 KiB source workspace into an ODC cpio archive. A seekable
        source is zlib-counted and rewound. If the compressed archive fits one
        128 KiB dvzip block and saves bytes, it is streamed in the proven zlib
        profile; otherwise it is streamed as bounded stored dvzip blocks,
        matching the native sender's adaptive choice for JPEG data. A fixed
        16 KiB network staging buffer coalesces producer writes; TLS writes
        remain below the lwIP send window. No complete file or archive is
        buffered.
        The exact TransferID returned by the accepted Ask is reused for a
        sequential Upload request on the same TCP/TLS connection, matching the
        observed anonymous native Mac-to-iPhone sender flow. There is no retry.
        Normal and web-flasher builds must leave this disabled.

config ESPDROP_RELAY_ARM_WINDOW_MS
    int "Host relay arm window before the AirDrop sender starts (ms)"
    depends on ESPDROP_AIRDROP_UPLOAD_LAB
    range 0 60000
    default 0
    help
        Give the USB host time after reset to replace a persisted spool with a
        live prepared stream. The application task waits, while USB maintenance
        remains active, and proceeds immediately once a live stream is armed.
        Keep this zero outside the attended relay profile.

config ESPDROP_AWDL_LAB_TARGET_MAC
    string "AWDL lab endpoint MAC (empty permits auto-selection)"
    depends on ESPDROP_AWDL_TX_LAB
    default ""
    help
        Optional colon-separated AWDL peer MAC that receives the research
        lab's direct IPv6 traffic. AirDrop endpoint tests are restricted to
        the same peer. Production builds leave this empty.

config ESPDROP_AWDL_LAB_AUTO_TARGET_AIRDROP
    bool "Automatically target a live AirDrop TCP advertiser"
    depends on ESPDROP_AWDL_TX_LAB
    default n
    help
        When no explicit target MAC is configured, collect fresh parsed MIF
        service responses advertising _airdrop._tcp, then bind the bounded
        experiment in RAM only when proximity selection is decisive. This
        follows rotating Apple AWDL identities without rebuilding firmware.
        An explicit target MAC always takes precedence. Production builds
        leave this disabled.

config ESPDROP_AWDL_AUTO_TARGET_SETTLE_MS
    int "AirDrop auto-target observation window (ms)"
    depends on ESPDROP_AWDL_LAB_AUTO_TARGET_AIRDROP
    range 250 10000
    default 1000
    help
        Observe candidates for this long after the first AirDrop MIF before
        selecting. This prevents the first advertiser from winning merely by
        arrival order.

config ESPDROP_AWDL_AUTO_TARGET_MAX_AGE_MS
    int "AirDrop auto-target candidate maximum age (ms)"
    depends on ESPDROP_AWDL_LAB_AUTO_TARGET_AIRDROP
    range 500 30000
    default 3000
    help
        Both the candidate's AWDL RSSI and AirDrop service evidence must have
        been refreshed within this interval.

config ESPDROP_AWDL_AUTO_TARGET_MIN_RSSI
    int "AirDrop auto-target minimum AWDL RSSI (dBm)"
    depends on ESPDROP_AWDL_LAB_AUTO_TARGET_AIRDROP
    range -127 0
    default -70

config ESPDROP_AWDL_AUTO_TARGET_MARGIN_DB
    int "AirDrop auto-target required RSSI margin (dB)"
    depends on ESPDROP_AWDL_LAB_AUTO_TARGET_AIRDROP
    range 0 40
    default 8
    help
        The nearest candidate must exceed the runner-up by at least this
        margin. Otherwise selection remains ambiguous and no connection starts.

config ESPDROP_AWDL_LAB_SCHEDULE_MAC
    string "AWDL lab schedule-source MAC"
    depends on ESPDROP_AWDL_TX_LAB
    default ""
    help
        Optional AWDL peer whose MIF supplies the channel sequence and timing.
        This can differ from the endpoint peer. The MIF's election TLV still
        supplies the actual synchronization-master identity. When empty, the
        endpoint MAC is the schedule source. Production builds leave this
        empty.

config ESPDROP_AWDL_LAB_DYNAMIC_ELECTION
    bool "Continuously elect the AWDL synchronization parent"
    depends on ESPDROP_AWDL_TX_LAB
    default y
    help
        Track fresh MIFs from all observed peers and continuously select the
        synchronization parent using the OWL election algorithm. The selected
        parent's timing and channel sequence replace the fixed schedule-source
        override. Normal and web-flasher builds never transmit regardless of
        this setting.

config TAPDROP_NFC_FIELD_GPIO
    int "NFC field-detect GPIO (-1 disables hardware input)"
    range -1 48
    default -1

config TAPDROP_NFC_ACTIVE_LEVEL
    int "NFC field-detect active level"
    range 0 1
    default 1

config TAPDROP_SESSION_WINDOW_MS
    int "Tap correlation window (milliseconds)"
    range 1000 60000
    default 15000

config TAPDROP_MINIMUM_SCORE
    int "Minimum correlation score"
    range 0 1000
    default 450

config TAPDROP_AMBIGUITY_MARGIN
    int "Required score margin over second candidate"
    range 0 1000
    default 100

endmenu
```

## sdkconfig.defaults
```kconfig
CONFIG_PARTITION_TABLE_CUSTOM=y
CONFIG_PARTITION_TABLE_CUSTOM_FILENAME="partitions.csv"
CONFIG_ESPTOOLPY_FLASHSIZE_16MB=y
CONFIG_ESPTOOLPY_FLASHMODE_DIO=y
CONFIG_ESPTOOLPY_FLASHFREQ_40M=y
CONFIG_SPIRAM=y
CONFIG_SPIRAM_MODE_OCT=y
CONFIG_SPIRAM_TYPE_ESPPSRAM64=y
CONFIG_SPIRAM_SPEED_80M=y
CONFIG_SPIRAM_USE_MALLOC=y
CONFIG_COMPILER_OPTIMIZATION_SIZE=y
CONFIG_ESP_DEFAULT_CPU_FREQ_MHZ_240=y
CONFIG_BT_ENABLED=y
CONFIG_BT_NIMBLE_ENABLED=y
CONFIG_BT_NIMBLE_ROLE_BROADCASTER=y
CONFIG_BT_NIMBLE_ROLE_OBSERVER=y
CONFIG_LWIP_IPV6=y
CONFIG_LWIP_IPV6_AUTOCONFIG=y
CONFIG_LWIP_MAX_SOCKETS=16
CONFIG_ESP_COREDUMP_ENABLE_TO_FLASH=y
CONFIG_ESP_CONSOLE_USB_SERIAL_JTAG=y
```
